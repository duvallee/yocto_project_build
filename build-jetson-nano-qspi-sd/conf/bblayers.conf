## build-jetson-nano-qspi-sd/conf/bblayers.conf
```bitbake
# POKY_BBLAYERS_CONF_VERSION is increased each time build/conf/bblayers.conf
# changes incompatibly
POKY_BBLAYERS_CONF_VERSION = "2"

BBPATH = "${TOPDIR}"
BSPDIR := "${@os.path.abspath(os.path.dirname(d.getVar('FILE', True)) + '/../..')}"

BBFILES ?= ""

BBLAYERS ?= " \
   ${BSPDIR}/source/poky/meta \
   ${BSPDIR}/source/poky/meta-poky \
   ${BSPDIR}/source/poky/meta-yocto-bsp \
   \
   ${BSPDIR}/source/meta-openembedded/meta-oe \
   ${BSPDIR}/source/meta-openembedded/meta-multimedia \
   ${BSPDIR}/source/meta-openembedded/meta-python \
   ${BSPDIR}/source/meta-openembedded/meta-gnome \
   ${BSPDIR}/source/meta-openembedded/meta-networking \
   ${BSPDIR}/source/meta-openembedded/meta-filesystems \
   \
   ${BSPDIR}/source/meta-tegra \
   ${BSPDIR}/source/meta-mender/meta-mender-core \
   ${BSPDIR}/source/meta-mender/meta-mender-demo \
   \
   ${BSPDIR}/source/meta-qt5 \
   \
   ${BSPDIR}/source/meta-jetson_nano \
  "
```

## build-qt-raspberrypi-4/conf/bblayers.conf
```bitbake
# POKY_BBLAYERS_CONF_VERSION is increased each time build/conf/bblayers.conf
# changes incompatibly
POKY_BBLAYERS_CONF_VERSION = "2"

BBPATH = "${TOPDIR}"
BSPDIR := "${@os.path.abspath(os.path.dirname(d.getVar('FILE', True)) + '/../..')}"

BBFILES ?= ""

BBLAYERS ?= " \
  ${BSPDIR}/source/poky/meta \
  ${BSPDIR}/source/poky/meta-poky \
  ${BSPDIR}/source/poky/meta-yocto-bsp \
  "

BBLAYERS += "${BSPDIR}/source/meta-openembedded/meta-oe "
BBLAYERS += "${BSPDIR}/source/meta-openembedded/meta-multimedia "
BBLAYERS += "${BSPDIR}/source/meta-openembedded/meta-networking "
BBLAYERS += "${BSPDIR}/source/meta-openembedded/meta-python "

# for ROS
# BBLAYERS += "${BSPDIR}/source/meta-ros/meta-ros1 "
# BBLAYERS += "${BSPDIR}/source/meta-ros/meta-ros1-melodic "
# BBLAYERS += "${BSPDIR}/source/meta-ros/meta-ros1-noetic "

BBLAYERS += "${BSPDIR}/source/meta-ros/meta-ros2 "
# BBLAYERS += "${BSPDIR}/source/meta-ros/meta-ros2-dashing "
# BBLAYERS += "${BSPDIR}/source/meta-ros/meta-ros2-eloquent "
# BBLAYERS += "${BSPDIR}/source/meta-ros/meta-ros2-foxy "
BBLAYERS += "${BSPDIR}/source/meta-ros/meta-ros2-galactic "
# BBLAYERS += "${BSPDIR}/source/meta-ros/meta-ros2-rolling "
BBLAYERS += "${BSPDIR}/source/meta-ros/meta-ros-backports-gatesgarth "
BBLAYERS += "${BSPDIR}/source/meta-ros/meta-ros-backports-hardknott "
BBLAYERS += "${BSPDIR}/source/meta-ros/meta-ros-common "
# BBLAYERS += "${BSPDIR}/source/meta-ros/meta-ros-python2 "
#

BBLAYERS += "${BSPDIR}/source/meta-raspberrypi "
BBLAYERS += "${BSPDIR}/source/meta-raspberrypi-custom "

BBLAYERS += "${BSPDIR}/source/meta-qt5 "
```

## build-raspberrypi-3b/conf/bblayers.conf
```bitbake
# POKY_BBLAYERS_CONF_VERSION is increased each time build/conf/bblayers.conf
# changes incompatibly
POKY_BBLAYERS_CONF_VERSION = "2"

BBPATH = "${TOPDIR}"
BBFILES ?= ""

BBLAYERS ?= " \
  /home/duvallee.lee/sdd/tmp/yocto_project/yocto_project/source/poky/meta \
  /home/duvallee.lee/sdd/tmp/yocto_project/yocto_project/source/poky/meta-poky \
  /home/duvallee.lee/sdd/tmp/yocto_project/yocto_project/source/poky/meta-yocto-bsp \
  "
```
